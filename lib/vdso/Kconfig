## lib/vdso/Kconfig
```kconfig
# SPDX-License-Identifier: GPL-2.0

config HAVE_GENERIC_VDSO
	bool

config GENERIC_GETTIMEOFDAY
	bool
	select HAVE_GENERIC_VDSO
	help
	  This is a generic implementation of gettimeofday vdso.
	  Each architecture that enables this feature has to
	  provide the fallback implementation.

config GENERIC_VDSO_OVERFLOW_PROTECT
	bool
	help
	  Select to add multiplication overflow protection to the VDSO
	  time getter functions for the price of an extra conditional
	  in the hotpath.

config VDSO_GETRANDOM
	bool
	select HAVE_GENERIC_VDSO
	help
	  Selected by architectures that support vDSO getrandom().
```
